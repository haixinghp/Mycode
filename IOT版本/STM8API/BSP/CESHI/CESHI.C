#include "config.h"

#if		CONF_CESHI_EN	

u8 CESHI=0;
/*******************************************************************************
* 函 数 名         : USART3_sendchar(u8 ch)
* 函数功能		   : 串口3发送数据位
* 输    入         : 无
* 输    出         : 无
*******************************************************************************/
u8 NO[16]={0x30,0x31,0x32,0x33,0x34,0x35,0x36,0x37,0x38,0x39,0x41,0x42,0x43,0x44,0x45,0x46};
void USART3_sendchar(u8 ch)
{
			USART_SendData8(USART3,ch);//通过外设USARTx发送单个数据
		
		while(USART_GetFlagStatus(USART3,USART_FLAG_TXE)==RESET);

}

/*******************************************************************************
* 函 数 名         : sendchar()
* 函数功能		   : 串口1发送数据位
* 输    入         : 无
* 输    出         : 无
*******************************************************************************/
void qwl_sendnumber(u16 ch)
{
  u8 display[6];
  display[4]=ch%10+0x30;
  display[3]=ch/10%10+0x30;
  display[2]=ch/100%10+0x30;
  display[1]=ch/1000%10+0x30;
  display[0]=ch/10000%10+0x30;
  display[5]=0x00;
   qwl_sendstring(display);
}
void qwl_sendchar(u8 ch)
{
   	
	USART3_sendchar(ch);
}

/*******************************************************************************
* 函 数 名         : send字符串()
* 函数功能		   : 串口1发送数据位
* 输    入         : 无
* 输    出         : 无
*******************************************************************************/
void qwl_sendstring(u8 *p)
{
  	while(*p)
  	{
  		qwl_sendchar(*p);
  		p++;
	}
	qwl_sendchar(0x0d);
	qwl_sendchar(0x0a);
}
/*******************************************************************************
* 函 数 名         : send字符串()
* 函数功能		   : 串口1发送数据位
* 输    入         : 无
* 输    出         : 无
*******************************************************************************/
void qwl_sendstring1(u8 *p)
{
  	while(*p)
  	{
  		qwl_sendchar(*p);
  		p++;
	}
}
#endif
/******************************************************************************/

